## arch/loongarch/Kconfig
```kconfig
#
# LoongArch Processor Configuration
#

if ARCH_LOONGARCH
comment "LoongArch Options"

choice
	prompt "LoongArch chip selection"
	default ARCH_CHIP_LOONGARCH_CUSTOM

config ARCH_CHIP_LS2K0300
	bool "Loongson 2K0300"
  select ARCH_LA64
	select ARCH_HAVE_INTERRUPTSTACK
	select ARCH_HAVE_CUSTOMOPT
  select ONESHOT
  select ONESHOT_COUNT
	---help---
		Loongson 2K0300 single-core processor.
		Frequency: typically 800MHz - 1.2GHz

config ARCH_CHIP_LOONGARCH_CUSTOM
    bool "Custom LoongArch chip"
    select ARCH_CHIP_CUSTOM
    ---help---
       Select this option if there is no directory for the chip under arch/loongarch/src/.

endchoice   # LoongArch chip selection

# Common LoongArch options
config ARCH_LA32
  bool
  default n

config ARCH_LA64
  bool
  default y
  select LIBC_ARCH_ELF_64BIT if LIBC_ARCH_ELF

config ARCH_HAVE_FPU
	bool
	default n
	---help---
		LS2K0300 does not support FPU.

config RAM_START
	hex "Start of RAM"
	default 0x9000000000000000
	---help---
		The physical start address of usable RAM.

config RAM_SIZE
	hex "End of RAM"
	default 0x10000000
	---help---
		The physical end address of usable RAM(256MB).

config ARCH_TEXT_BASE
    hex "Start address of kernel is loaded"
    default 0x9000000000200000
    ---help---
        Physical start address where kernel is loaded.
        For LS2K0300 with PMON/U-Boot, typical value is 0x9000000000200000.

config ARCH_HEAP_SIZE
	hex "Heap Size"
	default 0x04000000
	---help---
		Size of heap memory (64MB default).
		Adjust based on application requirements.

config ARCH_STACK_SIZE
	hex "Stack Size"
	default 0x01000000
	---help---
		Size of stack memory (16MB default).
		Includes idle thread stack and interrupt stack.

config ARCH_INTERRUPTSTACK
	int "Interrupt stack size"
	default 4096
	---help---
		Size of the interrupt stack for LS2K0300.

config LS2K0300_UART_BASEADDR
	hex "UART Base Address"
	default 0x1fe00000
	---help---
		Base address of UART for LS2K0300.
		Default is the SuperIO base address.

config LS2K0300_TIMER_FREQ
	int "Timer Frequency (Hz)"
	default 800000000
	---help---
		LS2K0300 timer frequency in Hz.

if !BARE_METAL

config PREALLOC_TIMERS
	int "Number of pre-allocated timers"
	default 4

config PREALLOC_WDOGS
	int "Number of pre-allocated watchdog timers"
	default 2

endif

config ARCH_FAMILY
  string
  default "la32"  if ARCH_LA32
  default "la64"  if ARCH_LA64

config ARCH_CHIP
    string
    default "ls2k0300"      if ARCH_CHIP_LS2K0300

if ARCH_CHIP_LS2K0300
source "arch/loongarch/src/ls2k0300/Kconfig"
endif

endif   # ARCH_LOONGARCH
```

## boards/loongarch/ls2k0300/pai_evb/Kconfig
```kconfig
#
# boards/loongarch/ls2k0300/pai_evb/Kconfig
#
# SPDX-License-Identifier: Apache-2.0
#
# Configuration options for the PAI-EVB (LS2K0300) evaluation board
#

if ARCH_BOARD_LS2K0300_PAI_EVB

menu "LS2K0300 Pai EVB Board Options"

config PAI_EVB_HAVE_SERIAL
	bool "Have UART Serial"
	default y
	---help---
		Select this if the board has UART for serial console.

config PAI_EVB_UART_INSTANCE
	int "UART instance for serial console"
	default 0
	range 0 3
	depends on PAI_EVB_HAVE_SERIAL
	---help---
		Select which UART instance (0-3) to use for serial console.
		UART0: Primary debug console (115200 baud)
		UART1-3: Additional serial interfaces

config PAI_EVB_HAVE_LED
	bool "Have LED"
	default y
	---help---
		Select this if the board has on-board LED for status indication.
		LED GPIO: Port 0, Pin 0

config PAI_EVB_HAVE_BUTTON
	bool "Have Button"
	default y
	---help---
		Select this if the board has on-board button for user input.
		Button GPIO: Port 0, Pin 1

config PAI_EVB_HAVE_ETHERNET
	bool "Have Ethernet"
	default n
	---help---
		Select this if the board has Ethernet interface.
		Note: Requires additional driver support.

config PAI_EVB_HAVE_I2C
	bool "Have I2C"
	default y
	---help---
		Select this if the board has I2C interface.
		I2C Clock: 100kHz
		Base Address: 0x1fe20000

config PAI_EVB_HAVE_SPI
	bool "Have SPI"
	default y
	---help---
		Select this if the board has SPI interface.
		SPI Clock: 25MHz
		Base Address: 0x1fee0000

config PAI_EVB_HAVE_NAND
	bool "Have NAND Flash"
	default y
	---help---
		Select this if the board has NAND flash memory.
		NAND Base Address: 0x1ffb0000
		NAND Size: 256MB (typical)

config PAI_EVB_NAND_BASE
	hex "NAND Flash Base Address"
	default 0x1ffb0000
	depends on PAI_EVB_HAVE_NAND
	---help---
		Base address of NAND flash controller.

config PAI_EVB_NAND_SIZE
	hex "NAND Flash Size"
	default 0x10000000
	depends on PAI_EVB_HAVE_NAND
	---help---
		Total size of NAND flash memory (typically 256MB).

config PAI_EVB_CLOCK_FREQ
	int "Board Clock Frequency (Hz)"
	default 800000000
	---help---
		PAI-EVB default clock frequency is 800MHz.
		Typical range: 800MHz - 1.2GHz depending on board revision.

menu "PAI-EVB Debug Options"

config PAI_EVB_DEBUG_UART
	bool "Debug UART"
	default n
	---help---
		Enable UART debugging output.
		Provides verbose debug messages on UART0.

config PAI_EVB_DEBUG_TIMER
	bool "Debug Timer"
	default n
	---help---
		Enable timer debugging output.
		Useful for timer interrupt debugging.

config PAI_EVB_DEBUG_IRQ
	bool "Debug IRQ"
	default n
	---help---
		Enable IRQ debugging output.
		Logs all interrupt and exception events.

config PAI_EVB_DEBUG_GPIO
	bool "Debug GPIO"
	default n
	---help---
		Enable GPIO debugging output.
		Logs GPIO configuration and state changes.

config PAI_EVB_DEBUG_I2C
	bool "Debug I2C"
	default n
	depends on PAI_EVB_HAVE_I2C
	---help---
		Enable I2C debugging output.

config PAI_EVB_DEBUG_SPI
	bool "Debug SPI"
	default n
	depends on PAI_EVB_HAVE_SPI
	---help---
		Enable SPI debugging output.

endmenu # PAI-EVB Debug Options

menu "PAI-EVB Performance Options"

config PAI_EVB_CPU_FREQ_SCALING
	bool "CPU Frequency Scaling"
	default n
	---help---
		Enable dynamic CPU frequency scaling for power management.

config PAI_EVB_CPU_BOOST
	bool "CPU Turbo Boost"
	default n
	depends on !PAI_EVB_CPU_FREQ_SCALING
	---help---
		Enable CPU turbo boost mode (1.2GHz).
		Note: Increases power consumption and heat generation.

endmenu # PAI-EVB Performance Options

endmenu # PAI-EVB Board Options

endif # ARCH_BOARD_PAI_EVB
```

## boards/loongarch/ls2k0300/pai_evb/configs/nsh/defconfig
```kconfig
# Architecture configuration
CONFIG_ARCH="loongarch"
CONFIG_ARCH_LOONGARCH=y
CONFIG_ARCH_CHIP="ls2k0300"
CONFIG_ARCH_CHIP_LS2K0300=y
CONFIG_ARCH_BOARD="pai_evb"
CONFIG_ARCH_BOARD_LS2K0300_PAI_EVB=y

# Build configuration - FLAT mode
CONFIG_BUILD_FLAT=y

# Processor configuration
CONFIG_ARCH_64BIT=y
CONFIG_ARCH_INTERRUPTSTACK=4096
CONFIG_IDLETHREAD_STACKSIZE=4096
CONFIG_SYSTEM_NSH=y
CONFIG_NSH_LIBRARY=y
CONFIG_INIT_ENTRYPOINT="nsh_main"

CONFIG_DISABLE_ALL_SIGNALS=y

# Memory configuration
CONFIG_RAM_START=0x9000000000000000
CONFIG_RAM_END=0x9000000010000000

# No FPU support
CONFIG_ARCH_FPU=n

# Interrupt configuration
#CONFIG_HAVE_NESTED_INTERRUPTS=y

# System Configuration
CONFIG_MSEC_PER_TICK=10
CONFIG_RR_INTERVAL=100
CONFIG_BOARD_LOOPSPERMSEC=1000

# Driver configuration
CONFIG_ARCH_HAVE_UART=y
CONFIG_UART0_ENABLED=y
CONFIG_UART0_SERIAL_CONSOLE=y
CONFIG_UART0_BAUD=115200
CONFIG_UART0_BITS=8
CONFIG_UART0_PARITY=0
CONFIG_UART0_STOPBITS=1
CONFIG_UART0_RXBUFSIZE=16
CONFIG_UART0_TXBUFSIZE=16

# Task/thread configuration
#CONFIG_PREALLOC_TIMERS=4
#CONFIG_PREALLOC_WDOGS=2

# Networking (optional)
#CONFIG_NET=n

# File system (optional)
#CONFIG_FS_ROMFS=y

# Debug configuration
CONFIG_DEBUG_ALERT=y
CONFIG_DEBUG_FEATURES=n

# Application configuration
CONFIG_NSH_BUILTIN_APPS=y
CONFIG_NSH_CONSOLE=y

# Toolchain configuration
CONFIG_ARCH_TOOLCHAIN_GNU=y
```
